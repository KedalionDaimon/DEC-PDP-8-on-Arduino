// telnet 192.168.4.1 8080
// or
// nc -C 192.168.4.1 8080

#pragma GCC optimize ("-O3")
#pragma GCC push_options

#define MEMSIZE 4096
#define EEPROM_SIZE 2048
// This thing should allow 8192 for a full memory dump.
// Because it does not, we shall save the userspace
// locations in FOCAL-69, given by LOCATIONS, and according
// to the manual (3200-5377)OCT = (1664-2815)DEC or
// 1660 to 2820 to remember it easier.

#define SRL Serial

#define Word unsigned short

#include "WiFi.h"
#include <EEPROM.h>

const char* ssid = "DEC-PDP8";
const char* password = "pdp8pass";
WiFiServer wifiServer(8080);
WiFiClient client = wifiServer.available();

const int STARTING_EEPROM_ADDRESS = 0;

  Word pc;

// As of this writing, this whole thing is a quick-and-dirty port of this amazing 256-LOC
// PDP-8 / 4K emulator: https://git.jeelabs.org/jcw/embello/src/branch/master/explore/1638-pdp8
// It was written for PC, and I ported it to Arduino - it definitely runs on DUE.
// Beware that the Arduino IDE builtin Serial monitor will not work (will not terminate lines
// correctly), so use some actual terminal emulator - I am using picocom. - To do all this,
// I ran jcw's original program, with the modification that I let it dump its memory right
// after it loaded FOCAL 69. Then, I removed all loading routines and simply placed the
// dump below into the mem-array, to let the machine have FOCAL 69 in memory a priori.
// I have not tested it, but it should be possible, if you program anything, to replace
// this dump with a new FOCAL 69 dump, containing your program. Hence, I modified the
// cleanup-function so that it simply presents such a dump once you press Ctrl-\ - enjoy!
// For instance, you can try this: FOR X=-10,1,10;TYPE X,!
// - Nino, 21st May 2020
Word mem[] = {

1464,2819,2819,1411,4,11,64,3328,1632,2404,63,1680,38,1050,
0,2404,0,4045,1287,2403,0,2403,0,1632,2040,2413,4094,0,0,
2815,0,0,1048,0,0,6,0,0,0,6,0,3459,1028,3540,4080,0,0,0,
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0, 0, 0, 0, 0, 0, 0, 0, 0, 0, 0, 0, 0, 0, 0, 0

};



Word mask(Word w) { return w & 07777; }
Word lmask(Word w) { return w & 017777; }

Word opAddr (int ir) {
    Word a = ir & 0177;
    if (ir & 0200)
        a |= (pc - 1) & 07600;
    if (ir & 0400) {
        if ((a & 07770) == 010)
            mem[a] = mask(mem[a] + 1);
        a = mem[a];
    }
    return a;
}

// This I simply turned into a memory dump, so if anything was
// programmed in FOCAL, it should be retained here and could be
// pasted later on at the top. - Nino
void cleanup () {

    SRL.println();
    SRL.println();
    client.println();
    client.println();
    int cntr;
    int decer = 0;
    for (cntr = 0; cntr < MEMSIZE; cntr++) {
      SRL.print(static_cast<int>(mem[cntr]));
      SRL.print(", ");
      client.print(static_cast<int>(mem[cntr]));
      client.print(", ");
      delay(0);
      decer++;
      if (decer == 12) {
        SRL.print("\r\n");
        client.print("\r\n");
        decer = 0;
      }
     
    }
    SRL.println();
    SRL.println();
    client.println();
    client.println();

}


void writeArrayIntoEEPROM(int address, Word numbers[])
{
  // 1660 to 2820
  EEPROM.begin(EEPROM_SIZE); delay(2000);
  int addressIndex = address;
  for (int i = 1660; i < 2820; i++) 
  {
    EEPROM.write(addressIndex, numbers[i] >> 8);
    EEPROM.write(addressIndex + 1, numbers[i] & 0xFF);
    addressIndex += 2;
  }
  EEPROM.commit();
  EEPROM.end();
}

void readArrayFromEEPROM(int address, Word numbers[])
{
  // 1660 to 2820
  EEPROM.begin(EEPROM_SIZE); delay(2000);
  int addressIndex = address;
  for (int i = 1660; i < 2820; i++)
  {
    numbers[i] = (EEPROM.read(addressIndex) << 8) + EEPROM.read(addressIndex + 1);
    addressIndex += 2;
  }
  EEPROM.end();
}


void setup() {

  // start serial port at 300 bps
  SRL.begin(9600);
  WiFi.softAP(ssid, password);
  delay(500);
  SRL.println("Establishing WiFi network.");
  wifiServer.begin();
  SRL.println(WiFi.softAPIP());

    pc = 0200;

    Word sr = 0;

    Word ac = 0, mq = 0;
    int iena = 0;

    int greeting = 1;
    
    for (;;) {
      
    client = wifiServer.available();

    if (client) {
        while (client.connected()) {

        if (greeting == 1) {
            greeting = 0;
            client.print(F("\r\n    WELCOME TO THE TOPSEQ SYSTEM IN FOCAL-69 ON AN ARDUINO PDP-8.\r\n"));
            delay(50);
            client.print(F("    THIS COMPUTER HAS BEEN SET TO RUN THE TOPSEQ SEMANTIC NETWORK.\r\n"));
            delay(50);
            client.print(F("    TOPSEQ IS SHORT FOR TOPIC SEQUENCER INDICATING THE NATURE OF\r\n"));
            delay(50);
            client.print(F("    THE SYSTEM. EACH INPUT CONSISTS OF EXACTLY SIX ONE-DIGIT\r\n"));
            delay(50);
            client.print(F("    POSITIVE OR NEGATIVE DECIMAL NUMBERS 1-9, E.G:\r\n"));
            delay(50);
            client.print(F("    1,2,3,4,5,6 RETURN. NOTE THAT 0 IS NOT USED AND MEANS NO TOPIC.\r\n"));
            delay(50);
            client.print(F("    THIS SETS A NEW SENTENCE INTO THE KNOWLEDGE BASE, AT ONCE\r\n"));
            delay(50);
            client.print(F("    FORGETTING THE OLDEST ONE. EACH NUMBER REPRESENTS A POSSIBLE\r\n"));
            delay(50);
            client.print(F("    TOPIC. THE TOPIC OF THE SENTENCE IS ALWAYS THE FIRST NUMBER\r\n"));
            delay(50);
            client.print(F("    GIVEN IN THE SENTENCE. IT CAN BE SEARCHED BY NOTING IT AS\r\n"));
            delay(50);
            client.print(F("    NEGATIVE DURING INPUT, AS 1,-2,-1,2,3,4 SEARCHES FOR SENTENCES\r\n"));
            delay(50);
            client.print(F("    BEGINNING WITH 2 AND 1 AND WILL INDEED FIND 1,2,3,4,5,6 AS IT\r\n"));
            delay(50);
            client.print(F("    BEGINS WITH 1. AT THE SAME TIME, THE SYSTEM WILL ALSO LEARN\r\n"));
            delay(50);
            client.print(F("    1,2,1,2,3,4, I.E. ALL TOPICS ARE STORED AS POSITIVE NUMBERS.\r\n"));
            delay(50);
            client.print(F("    IF YOU WISH TO ONLY SEARCH FOR A TERM, TRY E.G.\r\n"));
            delay(50);
            client.print(F("    -1,0,0,0,0,0 RETURN. IF A TOPIC OF INTEREST HAS BEEN\r\n"));
            delay(50);
            client.print(F("    SPECIFIED BY MINUS, A REPLY WILL BE MADE. OTHERWISE, THE\r\n"));
            delay(50);
            client.print(F("    SYSTEM WILL ONLY LEARN THE SENTENCE. THE KNOWLEDGE CONSISTS.\r\n"));
            delay(50);
            client.print(F("    OUT OF 60 SENTENCES. IF ANY SENTENCE IS INPUT THAT BEGINS WITH\r\n"));
            delay(50);
            client.print(F("    ZERO, THE INTERACTION TERMINATES AND THE KNOWLEDGE BASE IS\r\n"));
            delay(50);
            client.print(F("    PRINTED OUT. YOU ARE THEN RETURNED TO FOCAL-69. ERASE ALL\r\n"));
            delay(50);
            client.print(F("    IN FOCAL REMOVES THE AI UNTIL RESTART. TYPE GO TO COMMENCE.\r\n"));
            delay(50);
            client.print(F("    ~ DUMPS, { SAVES AND } GETS MEMORY: PRESS THE KEY, THEN ENTER.\r\n"));
        }

        iena >>= 1; // implements delayed enabling, relies on sign extension

        static char counter; // HACK: every 65536 ops, we fake an interrupt - made it 256 (char instead of short)
        if ((iena & 1) && ++counter == 0) {
            mem[0] = pc;
            pc = 1;
            iena = 0;
        }

        int ir = mem[pc];

        pc = mask(pc + 1);
        switch ((ir >> 9) & 07) {

            case 0: // AND
                ac &= mem[opAddr(ir)] | 010000;
                break;

            case 1: // TAD
                ac = lmask(ac + mem[opAddr(ir)]);
                break;

            case 2: { // ISZ
                Word t = opAddr(ir);
                mem[t] = mask(mem[t] + 1);
                if (mem[t] == 0)
                    pc = mask(pc + 1);
                break;
            }

            case 3: // DCA
                mem[opAddr(ir)] = mask(ac);
                ac &= 010000;
                break;

            case 4: { // JMS
                Word t = opAddr(ir);
                mem[t] = pc;
                pc = mask(t + 1);
                break;
            }

            case 5: // JMP
                pc = opAddr(ir);
                break;

            case 6: // IOT
                switch ((ir >> 3) & 077) {
                    case 00:
                        switch (ir) {
                            case 06001: iena = ~1; break; // delays one cycle
                            case 06002: iena = 0; break;
                            default:    {
                                        }
                        }
                        break;
                    case 03: // keyboard
                    
                        if (ir & 01) {
                          pc = mask(pc + 1);}
                        
                        if ((ir & 04) && (client.available()>0)) { // read byte
                            int b = 0;

                            b = client.read();

                            if ((b > 96) && (b < 123)) {b = b - 32;} // turn letters to CAPITALS
                            if (b == '~') { // cleanup on ~
                                client.print("\r\nQUIT\r\n");
                                SRL.print("\r\nQUIT\r\n");
                                cleanup();
                                
                                // return 4;
                                if (ir & 01) // skip if ready
                                    pc = mask(pc + 1);
                                if (ir & 04) { // send byte
                                   client.write(ac & 0177); // strip off parity
                                   SRL.write(ac & 0177);
                                   if ((ac & 0177) == '\n') {delay(4);}
                                //   fflush(stdout);
                                }
                                if (ir & 02) // clear flag
                                    ac &= 010000;
                            }

                            if (b == '{') {
                              b = ' ';
                              writeArrayIntoEEPROM(STARTING_EEPROM_ADDRESS, mem);
                              // for (int iii = 0; iii < MEMSIZE - 16; iii = iii + 1) { client.print(mem[iii]); client.print(","); }
                              client.print(F("\r\nMEMORY SAVED.\r\n"));
                            }

                            if (b == '}') {
                              b = ' ';
                              readArrayFromEEPROM(STARTING_EEPROM_ADDRESS, mem);
                              // for (int iii = 0; iii < MEMSIZE - 16; iii = iii + 1) { client.print(mem[iii]); client.print(","); }
                              client.print(F("\r\nMEMORY LOADED.\r\n"));
                            }
                            
                            ac = (ac & 010000) | b;
                        }

                    

                        
                        break;
                    case 04: // teleprinter
                        if (ir & 01) // skip if ready
                            pc = mask(pc + 1);
                        if (ir & 04) { // send byte
                            client.write(ac & 0177); // strip off parity
                            SRL.write(ac & 0177);
                            delay(20);
                            if ((ac & 0177) == '\n') {delay(20);}
                            // fflush(stdout);
                        }
                        if (ir & 02) // clear flag
                            ac &= 010000;
                        break;
                    default:
                        {
                        }
                        break;
                }
                break;

            case 7: // OPR
                if ((ir & 0400) == 0) { // group 1
                    if (ir & 0200) // CLA
                        ac &= 010000;
                    if (ir & 0100) // CLL
                        ac &= 07777;
                    if (ir & 040) // CMA
                        ac ^= 07777;
                    if (ir & 020) // CML
                        ac ^= 010000;
                    if (ir & 01) // IAC
                        ac = lmask(ac + 1);
                    switch (ir & 016) {
                        case 012: // RTR
                            ac = lmask((ac >> 1) | (ac << 12)); // fall through
                        case 010: // RAR
                            ac = lmask((ac >> 1) | (ac << 12));
                            break;
                        case 06: // RTL
                            ac = lmask((ac >> 12) | (ac << 1)); // fall through
                        case 04: // RAL
                            ac = lmask((ac >> 12) | (ac << 1));
                            break;
                        case 02: // BSW
                            ac = (ac & 010000) | ((ac >> 6) & 077)
                                                | ((ac << 6) & 07700);
                            break;
                    }
                } else if ((ir & 01) == 0) { // group 2
                    // SMA, SPA, SZA, SNA, SNL, SZL
                    int s = ((ir & 0100) && (ac & 04000)) ||
                            ((ir & 040) && (ac & 07777) == 0) ||
                            ((ir & 020) && (ac & 010000) != 0) ? 0 : 010;
                    if (s == (ir & 010))
                        pc = mask(pc + 1);
                    if (ir & 0200) // CLA
                        ac &= 010000;
                    if (ir & 04) // OSR
                        ac |= sr;
                    if (ir & 02) { // HLT
                        client.print("\r\nHALT "); client.println(mask(ac), OCT);
                        // return 0;
                    }
                } else { // group 3
                    Word t = mq;
                    if (ir & 0200) // CLA
                        ac &= 010000;
                    if (ir & 020) { // MQL
                        mq = ac & 07777;
                        ac &= 010000;
                    }
                    if (ir & 0100)
                        ac |= t;
                }
                break;
        }
    }}}
  

}

void loop() {}

#pragma GCC pop_options
