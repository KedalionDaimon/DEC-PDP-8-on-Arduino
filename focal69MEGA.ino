#define MEMSIZE 3952
// i.e. NOT the full 4096

#define SRL Serial

#define Word unsigned int

  Word pc;

// As of this writing, this whole thing is a quick-and-dirty port of this amazing 256-LOC
// PDP-8 / 4K emulator: https://git.jeelabs.org/jcw/embello/src/branch/master/explore/1638-pdp8
// It was written for PC, and I ported it to Arduino - it definitely runs on DUE.
// Beware that the Arduino IDE builtin Serial monitor will not work (will not terminate lines
// correctly), so use some actual terminal emulator - I am using picocom. - To do all this,
// I ran jcw's original program, with the modification that I let it dump its memory right
// after it loaded FOCAL 69. Then, I removed all loading routines and simply placed the
// dump below into the mem-array, to let the machine have FOCAL 69 in memory a priori.
// I have not tested it, but it should be possible, if you program anything, to replace
// this dump with a new FOCAL 69 dump, containing your program. Hence, I modified the
// cleanup-function so that it simply presents such a dump once you press Ctrl-\ - enjoy!
// For instance, you can try this: FOR X=-10,1,10;TYPE X,!
// - Nino, 21st May 2020
Word mem[] = {
0, 2819, 2819, 1411, 4, 11, 64, 3328, 0, 0, 0, 2296, 1615, 0, 3842, 1677, 0, 0, 1287, 0, 
0, 0, 1, 0, 0, 2032, 0, 0, 0, 2296, 0, 0, 0, 0, 0, 0, 0, 0, 0, 0, 
0, 3459, 1028, 3540, 0, 0, 0, 4080, 2032, 748, 1292, 1470, 1462, 1, 141, 0, 5, 0, 140, 135, 
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3712, 575, 2409, 3031, 0, 238, 587, 2409, 538, 3048, 7, 0
};



Word mask(Word w) { return w & 07777; }
Word lmask(Word w) { return w & 017777; }

Word opAddr (int ir) {
    Word a = ir & 0177;
    if (ir & 0200)
        a |= (pc - 1) & 07600;
    if (ir & 0400) {
        if ((a & 07770) == 010)
            mem[a] = mask(mem[a] + 1);
        a = mem[a];
    }
    return a;
}

// This I simply turned into a memory dump, so if anything was
// programmed in FOCAL, it should be retained here and could be
// pasted later on at the top. - Nino
void cleanup () {
    SRL.println();
    SRL.println();
    int cntr;
    int cont;
    int decer = 0;
    for (cntr = 0; cntr < MEMSIZE; cntr++) {
      cont = mem[cntr];
      SRL.print(cont);
      SRL.print(", ");
      decer++;
      if (decer == 12) {
        SRL.print("\r\n");
        decer = 0;
      }
     
    }
    SRL.println();
    SRL.println();

}

void setup() {

  

  // start serial port at 300 bps
  SRL.begin(1200);

    pc = 0200;

    Word sr = 0;

    Word ac = 0, mq = 0;
    int iena = 0;
    for (;;) {
        iena >>= 1; // implements delayed enabling, relies on sign extension

        static char counter; // HACK: every 256 ops, fake interrupt (changed short to char)
        if ((iena & 1) && ++counter == 0) {
            mem[0] = pc;
            pc = 1;
            iena = 0;
        }

        int ir = mem[pc];

        pc = mask(pc + 1);
        switch ((ir >> 9) & 07) {

            case 0: // AND
                ac &= mem[opAddr(ir)] | 010000;
                break;

            case 1: // TAD
                ac = lmask(ac + mem[opAddr(ir)]);
                break;

            case 2: { // ISZ
                Word t = opAddr(ir);
                mem[t] = mask(mem[t] + 1);
                if (mem[t] == 0)
                    pc = mask(pc + 1);
                break;
            }

            case 3: // DCA
                mem[opAddr(ir)] = mask(ac);
                ac &= 010000;
                break;

            case 4: { // JMS
                Word t = opAddr(ir);
                mem[t] = pc;
                pc = mask(t + 1);
                break;
            }

            case 5: // JMP
                pc = opAddr(ir);
                break;

            case 6: // IOT
                switch ((ir >> 3) & 077) {
                    case 00:
                        switch (ir) {
                            case 06001: iena = ~1; break; // delays one cycle
                            case 06002: iena = 0; break;
                            default:    { // SRL.print("IOT "); SRL.print(ir, OCT); SRL.print(" AC="); SRL.println(ac, OCT); 
                                        }
                        }
                        break;
                    case 03: // keyboard
                        if ((ir & 01) && SRL.available()) {
                          pc = mask(pc + 1);}
                        if (ir & 04) { // read byte
                            int b = SRL.read();
                            if (b == 0x1C) { // exit program on ctrl-backslash
                                SRL.print("\r\nQUIT\r\n");
                                cleanup();
                                
                                // return 4;
                                if (ir & 01) // skip if ready
                                    pc = mask(pc + 1);
                                if (ir & 04) { // send byte
                                   SRL.write(ac & 0177); // strip off parity
                                //   fflush(stdout);
                                }
                                if (ir & 02) // clear flag
                                    ac &= 010000;
                               
                            }
                            ac = (ac & 010000) | b;
                        }
                        break;
                    case 04: // teleprinter
                        if (ir & 01) // skip if ready
                            pc = mask(pc + 1);
                        if (ir & 04) { // send byte
                            SRL.write(ac & 0177); // strip off parity
                            // fflush(stdout);
                        }
                        if (ir & 02) // clear flag
                            ac &= 010000;
                        break;
                    default:
                        { // SRL.print("IOT "); SRL.print(ir, OCT); SRL.print(" AC="); SRL.println(ac, OCT); 
                        }
                        break;
                }
                break;

            case 7: // OPR
                if ((ir & 0400) == 0) { // group 1
                    if (ir & 0200) // CLA
                        ac &= 010000;
                    if (ir & 0100) // CLL
                        ac &= 07777;
                    if (ir & 040) // CMA
                        ac ^= 07777;
                    if (ir & 020) // CML
                        ac ^= 010000;
                    if (ir & 01) // IAC
                        ac = lmask(ac + 1);
                    switch (ir & 016) {
                        case 012: // RTR
                            ac = lmask((ac >> 1) | (ac << 12)); // fall through
                        case 010: // RAR
                            ac = lmask((ac >> 1) | (ac << 12));
                            break;
                        case 06: // RTL
                            ac = lmask((ac >> 12) | (ac << 1)); // fall through
                        case 04: // RAL
                            ac = lmask((ac >> 12) | (ac << 1));
                            break;
                        case 02: // BSW
                            ac = (ac & 010000) | ((ac >> 6) & 077)
                                                | ((ac << 6) & 07700);
                            break;
                    }
                } else if ((ir & 01) == 0) { // group 2
                    // SMA, SPA, SZA, SNA, SNL, SZL
                    int s = ((ir & 0100) && (ac & 04000)) ||
                            ((ir & 040) && (ac & 07777) == 0) ||
                            ((ir & 020) && (ac & 010000) != 0) ? 0 : 010;
                    if (s == (ir & 010))
                        pc = mask(pc + 1);
                    if (ir & 0200) // CLA
                        ac &= 010000;
                    if (ir & 04) // OSR
                        ac |= sr;
                    if (ir & 02) { // HLT
                        SRL.print("\r\nHALT "); SRL.println(mask(ac), OCT);
                        // return 0;
                    }
                } else { // group 3
                    Word t = mq;
                    if (ir & 0200) // CLA
                        ac &= 010000;
                    if (ir & 020) { // MQL
                        mq = ac & 07777;
                        ac &= 010000;
                    }
                    if (ir & 0100)
                        ac |= t;
                }
                break;
        }
    }
  

}

void loop() {}
